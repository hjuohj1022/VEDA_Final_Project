## Hardware/teensy/TeensyC/west.yml
```yaml
manifest:
  version: "0.13"

  remotes:
    - name: zephyrproject-rtos
      url-base: https://github.com/zephyrproject-rtos

  projects:
    - name: zephyr
      path: zephyr
      remote: zephyrproject-rtos
      revision: v2.7.1
      import: true
```

## RaspberryPi/yocto/meta-veda-rpi-yocto/conf/layer.conf
```bitbake
# We have a conf and classes directory, add to BBPATH
BBPATH .= ":${LAYERDIR}"

# We have recipes-* directories, add to BBFILES
BBFILES += "${LAYERDIR}/recipes-*/*/*.bb \
            ${LAYERDIR}/recipes-*/*/*.bbappend"

BBFILE_COLLECTIONS += "meta-veda-rpi-yocto"
BBFILE_PATTERN_meta-veda-rpi-yocto = "^${LAYERDIR}/"
BBFILE_PRIORITY_meta-veda-rpi-yocto = "6"

LAYERDEPENDS_meta-veda-rpi-yocto = "core"
LAYERSERIES_COMPAT_meta-veda-rpi-yocto = "scarthgap"
```
